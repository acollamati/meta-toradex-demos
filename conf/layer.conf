## conf/layer.conf
```bitbake
# We have a conf and classes directory, append to BBPATH
BBPATH .= ":${LAYERDIR}"

# We have recipes-* directories, add to BBFILES
BBFILES += "${LAYERDIR}/recipes-*/*/*.bb ${LAYERDIR}/recipes-*/*/*.bbappend"

BBFILE_COLLECTIONS += "toradex-demos"
BBFILE_PATTERN_toradex-demos = "^${LAYERDIR}/"
BBFILE_PRIORITY_toradex-demos = "90"

# Let us add layer-specific bbappends which are only applied when that
# layer is included in our configuration
BBFILES += "${@' '.join('${LAYERDIR}/%s/recipes*/*/*.bbappend' % layer \
               for layer in BBFILE_COLLECTIONS.split())}"
# Add layer-specific bb files too
BBFILES += "${@' '.join('${LAYERDIR}/%s/recipes*/*/*.bb' % layer \
               for layer in BBFILE_COLLECTIONS.split())}"

LAYERDEPENDS_toradex-demos = " \
    core \
    openembedded-layer gnome-layer multimedia-layer networking-layer \
    angstrom-layer \
    browser-layer \
    freescale-layer \
    fsl-demos \
    lxde-layer \
    qt4-layer \
    qt5-layer \
"
```
